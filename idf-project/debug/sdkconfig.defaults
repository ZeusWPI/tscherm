## idf-project/debug/sdkconfig.defaults
```kconfig
CONFIG_ESP_SYSTEM_PANIC_GDBSTUB=y
CONFIG_FREERTOS_HZ=1000

#CONFIG_PARTITION_TABLE_CUSTOM=y
#CONFIG_ESPTOOLPY_FLASHSIZE_4MB=y
```

## idf-project/release/sdkconfig.defaults
```kconfig
CONFIG_ESP32_DEFAULT_CPU_FREQ_240=y

CONFIG_FREERTOS_HZ=1000
# CONFIG_ESP_TASK_WDT_CHECK_IDLE_TASK_CPU0 is not set
# CONFIG_ESP_TASK_WDT_CHECK_IDLE_TASK_CPU1 is not set

CONFIG_ESP_SYSTEM_PANIC_GDBSTUB=y

CONFIG_PARTITION_TABLE_CUSTOM=y
CONFIG_ESPTOOLPY_FLASHSIZE_4MB=y

CONFIG_COMPILER_OPTIMIZATION_ASSERTIONS_DISABLE=y
CONFIG_COMPILER_OPTIMIZATION_PERF=y

CONFIG_LWIP_MULTICAST_PING=y
CONFIG_LWIP_BROADCAST_PING=y
```
